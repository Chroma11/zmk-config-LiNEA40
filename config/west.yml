## config/west.yml
```yaml
manifest:
  remotes:
    - name: cormoran
      url-base: https://github.com/cormoran
    - name: inorichi
      url-base: https://github.com/inorichi
    - name: keyfreaks
      url-base: https://github.com/kay-yokoyama
    - name: caksoylar
      url-base: https://github.com/caksoylar
  projects:
    - name: zmk
      remote: cormoran
      revision: v0.3-branch+dya
      import: app/west.yml
    # DYA Studio モジュールはすべて main ブランチで v0.3-branch+dya と API 非互換のため除外
    # 将来 cormoran 氏が互換バージョンを tag 付きでリリースしたら復活させる
    - name: zmk-pmw3610-driver
      remote: inorichi
      revision: main
    - name: zmk-rgbled-widget
      remote: caksoylar
      revision: v0.3-branch
  self:
    path: config
```
